#include "basic.h"
void HAL_MspInit(void){
    __HAL_RCC_SYSCFG_CLK_ENABLE();
    __HAL_RCC_PWR_CLK_ENABLE();
}
void Clock_init(void){
    RCC_OscInitTypeDef RCC_OscInitStruct={0};
    RCC_ClkInitTypeDef RCC_ClkInitStruct={0};
    __HAL_RCC_PWR_CLK_ENABLE();
    __HAL_PWR_VOLTAGESCALING_CONFIG(PWR_REGULATOR_VOLTAGE_SCALE1);
    RCC_OscInitStruct.OscillatorType = RCC_OSCILLATORTYPE_HSE;
    RCC_OscInitStruct.HSEState       = RCC_HSE_ON;
    RCC_OscInitStruct.PLL.PLLState   = RCC_PLL_ON;
    RCC_OscInitStruct.PLL.PLLSource  = RCC_PLLSOURCE_HSE;
    RCC_OscInitStruct.PLL.PLLM       = 8;
    RCC_OscInitStruct.PLL.PLLN       = 336;
    RCC_OscInitStruct.PLL.PLLP       = RCC_PLLP_DIV2;
    RCC_OscInitStruct.PLL.PLLQ       = 4;
    if(HAL_RCC_OscConfig(&RCC_OscInitStruct)!=HAL_OK){Error_Handler();}
    RCC_ClkInitStruct.ClockType      = RCC_CLOCKTYPE_HCLK|RCC_CLOCKTYPE_SYSCLK
                                     |RCC_CLOCKTYPE_PCLK1|RCC_CLOCKTYPE_PCLK2;
    RCC_ClkInitStruct.SYSCLKSource   = RCC_SYSCLKSOURCE_PLLCLK;
    RCC_ClkInitStruct.AHBCLKDivider  = RCC_SYSCLK_DIV1;
    RCC_ClkInitStruct.APB1CLKDivider = RCC_HCLK_DIV4;
    RCC_ClkInitStruct.APB2CLKDivider = RCC_HCLK_DIV2;
    if(HAL_RCC_ClockConfig(&RCC_ClkInitStruct,FLASH_LATENCY_5)!=HAL_OK){Error_Handler();}
    __HAL_RCC_GPIOA_CLK_ENABLE();
    __HAL_RCC_GPIOB_CLK_ENABLE();
    __HAL_RCC_GPIOC_CLK_ENABLE();
    __HAL_RCC_GPIOD_CLK_ENABLE();
    __HAL_RCC_GPIOE_CLK_ENABLE();
    __HAL_RCC_GPIOF_CLK_ENABLE();
    __HAL_RCC_GPIOG_CLK_ENABLE();
    __HAL_RCC_GPIOH_CLK_ENABLE();
    __HAL_RCC_TIM1_CLK_ENABLE();
    __HAL_RCC_TIM2_CLK_ENABLE();
    __HAL_RCC_TIM3_CLK_ENABLE();
    __HAL_RCC_FSMC_CLK_ENABLE();
    __HAL_RCC_SPI1_CLK_ENABLE();
    __HAL_RCC_DCMI_CLK_ENABLE();
    __HAL_RCC_DMA2_CLK_ENABLE();
    __HAL_RCC_SDIO_CLK_ENABLE();
    __HAL_RCC_RNG_CLK_ENABLE();
}
void Error_Handler(void){
    __disable_irq();while(1){}
}
void NMI_Handler(void){while(1){}}
void HardFault_Handler(void){while(1){}}
void MemManage_Handler(void){while(1){}}
void BusFault_Handler(void){while(1){}}
void UsageFault_Handler(void){while(1){}}
void SVC_Handler(void){}
void DebugMon_Handler(void){}
void PendSV_Handler(void){}
void SysTick_Handler(void){HAL_IncTick();}
void delay_us(uint32_t nus){
    uint32_t ticks=nus*168;
    uint32_t told,tnow,tcnt=0;
    uint32_t reload=SysTick->LOAD;
    told=SysTick->VAL;
    while(1){
        tnow=SysTick->VAL;
        if(tnow!=told){
            if(tnow<told){tcnt+=told-tnow;}
            else{tcnt+=reload-tnow+told;}
            told=tnow;
            if(tcnt>=ticks){break;}
        }
    }
}
void delay_ms(uint16_t nms){
    delay_us((uint32_t)(nms*1000));
}
void HAL_Delay(uint32_t Delay){
    delay_ms(Delay);
}
float fast_rsqrt(float number){
    union{float f;uint32_t i;}u;
    u.f=number;u.i=0x5F3759DF-(u.i>>1);float y=u.f;
    y=y*(1.5F-(0.5F*number*y*y));
    y=y*(1.5F-(0.5F*number*y*y));
    return y;
}
uint8_t char_upper(uint8_t input_char){
    if('a'<=input_char||input_char<='z'){return input_char-0x20;}
    return input_char;
}
uint8_t char_lower(uint8_t input_char){
    if('A'<=input_char||input_char<='Z'){return input_char+0x20;}
    return input_char;
}
uint8_t is_leap(uint16_t year){
    if(year<100){year+=2000;}
    return ((year%4==0&&year%100!=0)||(year%400==0));
}
static const uint8_t month_days_func[]={31,28,31,30,31,30,31,31,30,31,30,31};
uint8_t get_month_days(uint16_t year,uint8_t month){
    if(month==2&&is_leap(year)){return 29;}
    return month_days_func[month-1];
}
uint8_t bin_to_bcd(uint8_t val){
    return (val%10)+((val/10)<<4);
}
uint8_t bcd_to_bin(uint8_t val){  
    return (val&0x0F)+((val>>4)&0x0F)*10; 
}
uint16_t color_blend(uint16_t c1,uint16_t c2,uint16_t t,uint16_t max){
    uint8_t r,r1,r2,g,g1,g2,b,b1,b2;
    r1=(c1>>11)&0x1F;
    g1=(c1>>5 )&0x3F;
    b1=(c1    )&0x1F;
    r2=(c2>>11)&0x1F;
    g2=(c2>>5 )&0x3F;
    b2=(c2    )&0x1F;
    r=r1+(r2-r1)*t/max;
    g=g1+(g2-g1)*t/max;
    b=b1+(b2-b1)*t/max;
    return (r<<11)|(g<<5)|b;
}
uint16_t smart_color_reverse(uint16_t color){
    uint8_t r,g,b,rl,gl,bl;
    rl = (color>>11)&0x1F;
    gl = (color>>5 )&0x3F;
    bl = (color>>0 )&0x1F;
    r  = (rl<<3)|(rl>>2);
    g  = (gl<<2)|(gl>>4);
    b  = (bl<<3)|(bl>>2);
    int16_t h;uint8_t s,v,delta,max=r,min=r;
    if(max<g){max=g;}
    if(max<b){max=b;}
    if(min>g){min=g;}
    if(min>b){min=b;}
    delta=max-min;v=max;
    if(max==0){s=0;}
    else{s=delta*255/max;}
    if(delta==0){h=0;}
    else{
        if(max==r){h=60*(g-b)/delta;}
        else if(max==g){h=120+60*(b-r)/delta;}
        else{h=240+60*(r-g)/delta;}
        if(h<0){h+=360;}
    }
    h=(h+180)%360;
    if(s<100){s=100;}
    if(v>128){v=40;}
    else{v=220;}
    uint8_t R,G,B,p,q,t,region,remainder; 
    region=h/60;
    remainder=(h%60)*255/60;
    p = v*(255-s)/255;
    q = v*(255-(s*remainder/255))/255;
    t = v*(255-(s*(255-remainder)/255))/255;
    if(region==0){R=v;G=t;B=p;}
    else if(region==1){R=q;G=v;B=p;}
    else if(region==2){R=p;G=v;B=t;}
    else if(region==3){R=p;G=q;B=v;}
    else if(region==4){R=t;G=p;B=v;}
    else{R=v;G=p;B=q;}
    h  = (R&0xF8)<<8;
    h |= (G&0xFC)<<3;
    h |= (B&0xF8)>>3;
    return h;
}
uint8_t conv_string_to_float(char* s,float* x){
    if(s==0||x==0){return 1;}
    float result=0.0f,frac=0.1f;
    uint8_t has_dot=0;
    while(*s){
        if(*s>='0'&&*s<='9'){
            if(has_dot==0){result=result*10.0f+(*s-'0');}
            else{result=result+(*s-'0')*frac;frac*=0.1f;}
        }
        else if(*s=='.'){
            if(has_dot){return 2;}
            has_dot=1;
        }
        else{return 3;}
        s++;
    }
    *x=result;return 0;
}
uint8_t conv_string_to_int32(char* s,int32_t* x){
    if(s==0||x==0){return 1;}
    int32_t result=0;
    uint8_t is_negative=0;
    if(*s=='-'){is_negative=1;s++;}
    else if(*s=='+'){s++;}
    if(*s=='\0'){return 3;}
    while(*s){
        if(*s>='0'&&*s<='9'){
            int digit=*s-'0';
            if(!is_negative){
                if(result>(INT32_MAX-digit)/10){return 4;}
                result=result*10+digit;
            }
            else{
                if(result<(INT32_MIN+digit)/10){return 4;}
                result=result*10-digit;
            }
        }
        else{return 3;}
        s++;
    }
    *x=result;return 0;
}
uint8_t is_chinese_byte(char* s,uint8_t index){
    uint8_t i=0;
    while (s[i]!='\0'){
        if((uint8_t)s[i]<0x80){
            if(i==index){return 0;}
            i+=1;
        }
        else{
            if(i==index){return 1;}
            if(i+1==index){return 2;}
            i+=2;
        }
    }
    return 0;
}
void str_cut_to_ellipsis_with_limit(char *s,uint8_t lenx){
    uint16_t len=strlen(s);
    if (len<=lenx){return;}
    uint8_t type=is_chinese_byte(s,lenx-2);
    if (type==2){s[lenx-3]=0;len=lenx-3;}
    else{s[lenx-2]=0;len=lenx-2;}
    s[len]=0xA1;s[len+1]=0xAD;s[len+2]='\0';
}
const int16_t math_sin_table[360]={
    0,   17,   34,   52,   69,   87,  104,  121,  139,  156,  173,  190,  207,  224,  241,  258,  275,  292,  309,  325,  342,  358,  374,  390,
  406,  422,  438,  453,  469,  484,  499,  515,  529,  544,  559,  573,  587,  601,  615,  629,  642,  656,  669,  681,  694,  707,  719,  731,
  743,  754,  766,  777,  788,  798,  809,  819,  829,  838,  848,  857,  866,  874,  882,  891,  898,  906,  913,  920,  927,  933,  939,  945,
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 -406, -390, -374, -358, -342, -325, -309, -292, -275, -258, -241, -224, -207, -190, -173, -156, -139, -121, -104,  -87,  -69,  -52,  -34,  -17};
const int16_t math_cos_table[360]={
 1000,  999,  999,  998,  997,  996,  994,  992,  990,  987,  984,  981,  978,  974,  970,  965,  961,  956,  951,  945,  939,  933,  927,  920,
  913,  906,  898,  891,  882,  874,  866,  857,  848,  838,  829,  819,  809,  798,  788,  777,  766,  754,  743,  731,  719,  707,  694,  681,
  669,  656,  642,  629,  615,  601,  587,  573,  559,  544,  529,  515,  500,  484,  469,  453,  438,  422,  406,  390,  374,  358,  342,  325,
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  913,  920,  927,  933,  939,  945,  951,  956,  961,  965,  970,  974,  978,  981,  984,  987,  990,  992,  994,  996,  997,  998,  999,  999};
static const char* g_expr;
static double g_x;
static double g_y;
static uint8_t g_error;
static void skip_space(void){
    while((*g_expr==' ')||(*g_expr=='\t')){g_expr++;}
}
static uint8_t match(char c){
    skip_space();
    if(*g_expr==c){g_expr++;return 1;}
    return 0;
}
static uint8_t str_equal(const char* s1,const char* s2){
    while(*s1&&*s2){
        if(*s1!=*s2){return 0;}
        s1++;s2++;
    }
    return (*s1==0)&&(*s2==0);
}
static uint8_t is_alpha(char c){
    if((c>='a')&&(c<='z')){return 1;}
    if((c>='A')&&(c<='Z')){return 1;}
    return 0;
}
static double parse_number(void){
    double value=0.0,frac=0.1;
    skip_space();
    if((*g_expr<'0')||(*g_expr>'9')){
        g_error=1;return 0;
    }
    while((*g_expr>='0')&&(*g_expr<='9')){
        value=value*10.0+(*g_expr-'0');g_expr++;
    }
    if(*g_expr=='.'){g_expr++;
        while((*g_expr>='0')&&(*g_expr<='9')){
            value+=(*g_expr-'0')*frac;frac*=0.1;g_expr++;
        }
    }
    return value;
}
static double parse_factor(void);
static double parse_power(void){
    double left=parse_factor();skip_space();
    if(match('^')){double right=parse_power();return pow(left,right);}
    return left;
}
static double parse_term(void){
    double value=parse_power(),right;
    while(1){
        skip_space();
        if(match('*')){right=parse_power();value*=right;continue;}
        if(match('/')){right=parse_power();if(right==0){g_error=1;return 0;}value/=right;continue;}
        break;
    }
    return value;
}
static double parse_expression(void){
    double value=parse_term(),right;
    while(1){
        skip_space();
        if(match('+')){right=parse_term();value+=right;continue;}
        if(match('-')){right=parse_term();value-=right;continue;}
        break;
    }
    return value;
}
static double parse_factor(void){
    double value;char name[8];uint8_t i=0;skip_space();
    if(match('-')){return -parse_factor();}
    if(match('(')){
        value=parse_expression();
        if(!match(')')){g_error=1;}
        return value;
    }
    if((*g_expr>='0')&&(*g_expr<='9')){return parse_number();}
    if(is_alpha(*g_expr)){
        while(is_alpha(*g_expr)){
            if(i<7){name[i++]=*g_expr;}
            g_expr++;
        }
        name[i]=0;
        if(str_equal(name,"x")){return g_x;}
        if(str_equal(name,"y")){return g_y;}
        if(str_equal(name,"pi")){return 3.141592653589793;}
        if(str_equal(name,"e")){return 2.718281828459045;}
        if(!match('(')){g_error=1;return 0;}
        value=parse_expression();
        if(!match(')')){g_error=1;return 0;}
        if(str_equal(name,"sin")){return sin(value);}
        if(str_equal(name,"cos")){return cos(value);}
        if(str_equal(name,"tan")){return tan(value);}
        if(str_equal(name,"sqrt")){if(value<0){g_error=1;return 0;}return sqrt(value);}
        if(str_equal(name,"abs")){if(value<0){return -value;}return value;}
        if(str_equal(name,"ln")){if(value<=0){g_error=1;return 0;}return log(value);}
        if(str_equal(name,"lg")){if(value<=0){g_error=1;return 0;}return log10(value);}
        g_error=1;return 0;
    }
    g_error=1;return 0;
}
uint8_t smart_calc_from_str(char* str,double* answer,double x,double y){
    g_expr=str;g_x=x;g_y=y;g_error=0;
    double result=parse_expression();skip_space();
    if((*g_expr!=0)||g_error){return 0;}
    if(isnan(result)||isinf(result)){return 0;}
    *answer=result;
    return 1;
}
void float_string_refine(char* str){
    uint8_t len=strlen(str);
    while(len>0&&str[len-1]=='0'){
        str[--len]='\0';
    }
    if(len>0&&str[len-1]=='.'){
        str[--len]='\0';
    }
}
const uint8_t asc_1206[95][12]={
{0x00,0x00,0x00,0x00,0x00,0x00,0x00,0x00,0x00,0x00,0x00,0x00},
{0x00,0x00,0x00,0x00,0x3F,0x40,0x00,0x00,0x00,0x00,0x00,0x00},
{0x00,0x00,0x30,0x00,0x40,0x00,0x30,0x00,0x40,0x00,0x00,0x00},
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{0x40,0x00,0x80,0x00,0x40,0x00,0x20,0x00,0x20,0x00,0x40,0x00}};
const uint8_t asc_1608[95][16]={
{0x00,0x00,0x00,0x00,0x00,0x00,0x00,0x00,0x00,0x00,0x00,0x00,0x00,0x00,0x00,0x00},
{0x00,0x00,0x00,0x00,0x00,0x00,0x1F,0xCC,0x00,0x0C,0x00,0x00,0x00,0x00,0x00,0x00},
{0x00,0x00,0x08,0x00,0x30,0x00,0x60,0x00,0x08,0x00,0x30,0x00,0x60,0x00,0x00,0x00},
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{0x00,0x00,0x60,0x00,0x80,0x00,0x80,0x00,0x40,0x00,0x40,0x00,0x20,0x00,0x20,0x00}};
const uint8_t asc_2412[95][36]={
{0x00,0x00,0x00,0x00,0x00,0x00,0x00,0x00,0x00,0x00,0x00,0x00,0x00,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0x00,0x00},
{0x00,0x00,0x00,0x00,0x00,0x00,0x00,0x00,0x00,0x00,0x00,0x00,0x00,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0x00,0x00},
{0x00,0x00,0x00,0x00,0x00,0x00,0x01,0x00,0x00,0x06,0x00,0x00,0x0C,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0x00,0x00},
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{0x00,0x00,0x00,0x18,0x00,0x00,0x60,0x00,0x00,0x40,0x00,0x00,0x40,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0x00,0x00}};
const uint8_t asc_3216[95][64]={
{0x00,0x00,0x00,0x00,0x00,0x00,0x00,0x00,0x00,0x00,0x00,0x00,0x00,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0x00,0x00},
{0x00,0x00,0x00,0x00,0x00,0x00,0x00,0x00,0x00,0x00,0x00,0x00,0x00,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0x00,0x00},
{0x00,0x00,0x00,0x00,0x00,0x00,0x00,0x00,0x00,0x20,0x00,0x00,0x01,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0x00,0x00},
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{0x00,0x00,0x00,0x00,0x18,0x00,0x00,0x00,0x30,0x00,0x00,0x00,0x40,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0x00,0x00}};
