#include "icons.h"
void circle_width3(uint16_t x,uint16_t y,uint16_t r,uint16_t color){
    if(r<3){return;}
    int r_out=r,r_in=r-3;
    int xr_out=r_out,xr_in=r_in;
    int sq_out=r_out*r_out,sq_in=r_in*r_in;
    for(int i=0;i<=r_out;i++){
        while((i*i+xr_out*xr_out)>sq_out){xr_out--;}
        if(i<=r_in){
            while((i*i+xr_in*xr_in)>sq_in){xr_in--;}
        }
        else{
            xr_in=-1;
        }
        int left_out  = x-xr_out;
        int right_out = x+xr_out;
        int left_in   = x-xr_in;
        int right_in  = x+xr_in;
        if(xr_in>=0){
            Lcd_draw_line(left_out,y+i,left_in-left_out,0,color);
            Lcd_draw_line(right_in,y+i,right_out-right_in,0,color);
        }
        else{
            Lcd_draw_line(left_out,y+i,right_out-left_out,0,color);
        }
        if(i!=0){
            if(xr_in>=0){
                Lcd_draw_line(left_out,y-i,left_in-left_out,0,color);
                Lcd_draw_line(right_in,y-i,right_out-right_in,0,color);
            }
            else{
                Lcd_draw_line(left_out,y-i,right_out-left_out,0,color);
            }
        }
    }
}
static const uint16_t app_color_green_black=0x358F;
static const uint16_t app_color_green_light=0xC7F7;
static const uint8_t icon_draw_datas[6][288]={
{0x00,0x00,0x00,0x00,0x00,0x00,0x00,0x80,0x01,0x80,0x01,0x00,0x00,0xE0,0x03,0xC0,
0x07,0x00,0x00,0xF0,0x07,0xE0,0x0F,0x00,0x00,0xFC,0x0F,0xF0,0x3F,0x00,0x00,0xFE,
0x3F,0xFC,0x7F,0x00,0x00,0xFF,0xFF,0xFF,0xFF,0x00,0x00,0xFF,0xFF,0xFF,0xFF,0x00,
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0xFF,0xFF,0x00,0x00,0x00,0x00,0xF8,0x1F,0x00,0x00,0x00,0x00,0x00,0x00,0x00,0x00}};
static const uint8_t show_main_stp_data[1320]={
0xFF,0xFF,0xFF,0xFF,0xFF,0xFF,0xFF,0xFF,0xFF,0xFF,0xFF,0xFF,0xFF,0xFF,0xFF,0xFF,
0xFF,0xFF,0xFF,0xFF,0xFF,0xFF,0xFF,0xFF,0xFF,0xFF,0xFF,0xFF,0xFF,0xFF,0xFF,0xFF,
0xFF,0xFF,0xFF,0xFF,0xFF,0xFF,0xFF,0xFF,0x8B,0x23,0xFF,0xDC,0x37,0xFF,0xCB,0x46,
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0xFF,0xFF,0xFF,0xFF,0xFF,0xFF,0xFF,0x96};
static const char icon_draw_strs[6][5]={"设置","主页","录入","回收","警告","其他"};
inline static void draw_special(uint16_t x,uint16_t y,uint8_t index,uint16_t color,uint16_t bgcolor){
    Lcd_draw_icon_lowebit(x,y,48,48,(uint8_t*)icon_draw_datas[index],color,bgcolor);
}
inline void page_lcd_clear(uint16_t color){
    Lcd_draw_rect(0,32,480,672,color,1);
}
void Icon_show_main_stp(void){
    Lcd_clear(0xFFFF);uint16_t x=108,y=268;
    for(uint16_t i=0;i<1320;i++){
        uint8_t byte=show_main_stp_data[i];
        uint8_t val=(byte>>7)&0x01;
        uint8_t count=byte&0x7F;
        uint16_t pixel_color=val?0xFFFF:0x0000;
        for(uint8_t j=0;j<count;j++){
            Lcd_set_point(x,y,pixel_color);
            x+=1;if(x==372){x=108;y+=1;}
        }
    }
    Lcd_set_window(0,0,480,800);
    Lcd_draw_str_magnify(80,536,"By Inseven",32,2,0x0000,1,0);
}
void Camera_icon_draw(uint16_t x,uint16_t y,uint16_t color){
    uint8_t temp;uint16_t x0=x;
    for(uint16_t i=0;i<288;i++){
        temp=icon_draw_datas[2][i];
        for(uint8_t j=0;j<8;j++){
            if(temp&0x01){
                Lcd_set_point(x  ,y  ,color);
                Lcd_set_point(x  ,y+1,color);
                Lcd_set_point(x+1,y  ,color);
                Lcd_set_point(x+1,y+1,color);
            }
            temp>>=1;
            x+=2;
            if((x-x0)==96){
                x=x0;
                y+=2;
                break;
            }
        }
    }
}
uint8_t Icon_index_now;
uint8_t Icon_can_press;
uint32_t sys_count_icon;
void Icons_init_set(uint8_t x){
    Icon_index_now=x;
    Icon_can_press=1;
    sys_count_icon=0;
}
void Icons_draw(void){
    uint16_t base_x=0;
    for(uint8_t i=0;i<6;i++){
        if(i==Icon_index_now){base_x+=80;continue;}
        Lcd_draw_rect(base_x,704,80,96,app_color_green_light,1);
        base_x+=16;
        draw_special(base_x,712,i,app_color_green_black,app_color_green_light);
        Lcd_draw_str_chinese(base_x,766,(char*)icon_draw_strs[i],24,app_color_green_black,0,app_color_green_light);
        base_x+=64;
    }
    base_x=Icon_index_now*80;
    Lcd_draw_rect(base_x,704,80,96,app_color_green_black,1);
    base_x+=16;
    draw_special(base_x,712,Icon_index_now,app_color_green_light,app_color_green_black);
    Lcd_draw_str_chinese(base_x,766,(char*)icon_draw_strs[Icon_index_now],24,app_color_green_light,0,app_color_green_black);
}
void Icons_update_draw(uint8_t ix_before,uint8_t ix_after){
    Lcd_draw_rect(ix_before*80,704,80,96,app_color_green_light,1);
    draw_special(ix_before*80+16,712,ix_before,app_color_green_black,app_color_green_light);
    Lcd_draw_str_chinese(ix_before*80+16,766,(char*)icon_draw_strs[ix_before],24,app_color_green_black,0,app_color_green_light);
    Lcd_draw_rect(ix_after*80,704,80,96,app_color_green_black,1);
    draw_special(ix_after*80+16,712,ix_after,app_color_green_light,app_color_green_black);
    Lcd_draw_str_chinese(ix_after*80+16,766,(char*)icon_draw_strs[ix_after],24,app_color_green_light,0,app_color_green_black);
}
uint8_t Icons_touch_get(uint16_t x,uint16_t y){
    if(Icon_can_press==0){return 0;}
    if(y<704){return 0;}
    uint8_t index_get=x/80;
    if(index_get!=Icon_index_now){
        Icons_update_draw(Icon_index_now,index_get);
        Icon_index_now=index_get;
        return 1;
    }
    else{
        return 0;
    }
}
